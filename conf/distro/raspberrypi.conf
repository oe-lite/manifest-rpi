## conf/distro/raspberrypi.conf
```bitbake
#@TYPE: Distribution
#@NAME: raspberrypi
#@DESCRIPTION: OE-lite distro for Raspberry Pi

require conf/distro/busybox-full.conf
require conf/distro/linaro.conf

DISTRO_VERSION = "1.0-rc0"

#
# crosstool-ng setup
#
GCC_UPSTREAM_VERSION = "4.7"
GCC_LINARO_VERSION = "2012.10"

GDB_UPSTREAM_VERSION = "7.5"
GDB_LINARO_VERSION = "2012.09"

PREFERRED_VERSION_gcc = "1.17.0"
DISTRO_USE_machine_libc = "eglibc:2_16:r21913"
DISTRO_USE_toolchain_binutils_version = "2.22"


#
# Common options
#
DISTRO_USE_sysvinit = "1"
DISTRO_USE_crontab = "1"
DISTRO_USE_mdev = "1"
DISTRO_USE_inetd = "1"

DISTRO_USE_passwd_root = "$1$L9mzJfTZ$2ED5as2K2yZ98CN/BQuy1."

#
# Base-files setup
# 
DISTRO_USE_hostname = "rpi-host"
DISTRO_USE_busybox_ntpd_configuration = "-p 0.europe.pool.ntp.org -p 1.europe.pool.ntp.org"

#
# other pinnedversions
#
PREFERRED_VERSION_busybox = "1.21.0"
```

## conf/local.conf.sample
```bitbake
DISTRO	= "raspberrypi"
MACHINE = "rpi"


# Use one of these for selecting machine architecture
#MACHINE	?= "mpc8313erdb"
#MACHINE	?= "imx53qsb"
#MACHINE	?= "beagleboard"
#MACHINE	?= "pandaboard"

#MACHINE_CPU	 = "powerpc-mpc8313"
#MACHINE_CPU	 = "arm-at91rm9200"
#MACHINE_CPU	 = "arm-omap3520"
#MACHINE_CPU	 = "i686-mmx"

PROVIDED	 = "all"

# MinGW32 SDK
#SDK_CPU	 = "i686"
#SDK_OS		 = "mingw32"

# 32-bit Linux SDK (64-bit compatible)
SDK_CPU		 = "i686"
SDK_OS		 = "linux-gnu"

# Uncomment this to keep workdir intact after successful build
RMWORK		 = "0"

# Set this to 1 for defaulting to --relaxed or 2 for defaulting to --sloppy
#DEFAULT_RELAX	 = "1"

# Point to any available prebaked packages
#PREBAKE_PATH	 = "${TOPDIR}/prebake"

# Uncomment these to do enable parallel make
#PARALLEL_MAKE	 = "-j 4"
```

## conf/machine/rpi.conf
```bitbake
MACHINE_USE_kernel_imagetype = "Image"
MACHINE_USE_netbase_auto_if = "lo eth0"
MACHINE_USE_busybox_inittab_login = "::respawn:/sbin/getty 115200 /dev/ttyAMA0 vt100"

MACHINE_CPU	= "arm-1176jzfs"
MACHINE_ABI	= "hard"
MACHINE_USE_toolchain_kernel_version_machine = "custom"

#
# firmware for bootup / graphics, video, etc see meta/bcm2835/recipes/firmware.inc
#
FW_SRCREV = "commit=3ab17ac25e92ade48325472994b6660c5efd05b5"
FW_DATE   = "20130821"
```
